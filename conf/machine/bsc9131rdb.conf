## conf/machine/bsc9131rdb.conf
```bitbake
#@TYPE: Machine
#@DESCRIPTION: Machine configuration for running 

require e500v2.inc
require conf/machine/include/soc-family.inc

SOC_FAMILY = "bsc9131"
UBOOT_MACHINES ?= "BSC9131RDB BSC9131RDB_SPIFLASH"
KERNEL_DEVICETREE = "${S}/arch/powerpc/boot/dts/bsc9131rdb.dts"
KERNEL_DEFCONFIG = "${S}/arch/powerpc/configs/qoriq_sdk_asf_term_defconfig"

JFFS2_ERASEBLOCK = "0x10000"

SERIAL_CONSOLES = "115200;ttyS0 115200;ttyS1 115200;ttyEHV0"
SERIAL_CONSOLES_CHECK = "${SERIAL_CONSOLES}"
USE_VT = "0"
```

## conf/machine/c293pcie.conf
```bitbake
#@TYPE: Machine
#@DESCRIPTION: Machine configuration for running C293PCIE in 36-bit mode

require e500v2.inc
require conf/machine/include/soc-family.inc

SOC_FAMILY = "c293pcie"
UBOOT_MACHINES ?= "C293PCIE C293PCIE_SPIFLASH "
KERNEL_DEVICETREE = "${S}/arch/powerpc/boot/dts/c293pcie_36b.dts"
KERNEL_DEFCONFIG = "${S}/arch/powerpc/configs/mpc85xx_defconfig"

JFFS2_ERASEBLOCK = "0x10000"

SERIAL_CONSOLES = "115200;ttyS0 115200;ttyS1 115200;ttyEHV0"
SERIAL_CONSOLES_CHECK = "${SERIAL_CONSOLES}"
USE_VT = "0"
```

## conf/machine/include/qoriq-base.inc
```bitbake
# Provides the QorIQ common settings
require conf/machine/include/soc-family.inc

# providers
PREFERRED_PROVIDER_virtual/kernel ?= "linux-qoriq"
PREFERRED_PROVIDER_u-boot ?= "u-boot-qoriq"

# versions
PREFERRED_VERSION_qemu = "1.7+fsl"
PREFERRED_VERSION_valgrind_e500v2 = "3.8.1+fsl"
PREFERRED_VERSION_ptpd = "2.3.0"

# settings
MACHINE_FEATURES = "keyboard pci ext2 ext3 serial"
MACHINE_EXTRA_RRECOMMENDS += "udev-extraconf kernel-modules"

IMAGE_CLASSES += "image_types_uboot"
EXTRA_IMAGEDEPENDS += "u-boot"

KERNEL_IMAGETYPE ?= "uImage"

MACHINEOVERRIDES .= ":qoriq-ppc"

SERIAL_CONSOLES ?= "115200;ttyS0 115200;ttyS1 115200;ttyEHV0"
SERIAL_CONSOLES_CHECK ?= "${SERIAL_CONSOLES}"

USE_VT = "0"

MKUBIFS_ARGS ??= "-m 512 -e 15360 -c 12000"
UBINIZE_ARGS ??= "-m 512 -p 16KiB -s 512"
```

## conf/machine/include/qoriq-default-versions.inc
```bitbake
PREFERRED_VERSION_qemu = "1.7+fsl"
PREFERRED_VERSION_valgrind_e500v2 = "3.8.1+fsl"
PREFERRED_VERSION_ptpd = "2.3.0"
```

## conf/machine/p1020rdb.conf
```bitbake
#@TYPE: Machine
#@DESCRIPTION: Machine configuration for running 

require e500v2.inc

BOOTFORMAT_CONFIG = "config_ddr3_1gb_p1_p2_rdb_pc_800M.dat"
UBOOT_MACHINES ?= " P1020RDB-PD"

KERNEL_DEVICETREE = "${S}/arch/powerpc/boot/dts/p1020rdb-pd_32b.dts"

KERNEL_DEFCONFIG = "${S}/arch/powerpc/configs/mpc85xx_smp_defconfig"

JFFS2_ERASEBLOCK = "0x20000"

SERIAL_CONSOLES = "115200;ttyS0 115200;ttyS1 115200;ttyEHV0"
SERIAL_CONSOLES_CHECK = "${SERIAL_CONSOLES}"
USE_VT = "0"
```

## conf/machine/t1040qds-64b.conf
```bitbake
#@TYPE: Machine
#@DESCRIPTION: Machine configuration for running T1040QDS in 64-bit mode

require e5500-64b.inc
require conf/machine/include/soc-family.inc

SOC_FAMILY = "t1040"
UBOOT_MACHINES ?= "T1040QDS"
KERNEL_DEVICETREE ?= "${S}/arch/powerpc/boot/dts/t1040qds.dts \
    ${S}/arch/powerpc/boot/dts/t1040qds-usdpaa.dts"
KERNEL_DEFCONFIG ?= "${S}/arch/powerpc/configs/corenet64_smp_defconfig"

JFFS2_ERASEBLOCK = "0x10000"

SERIAL_CONSOLES = "115200;ttyS0 115200;ttyS1 115200;ttyEHV0"
SERIAL_CONSOLES_CHECK = "${SERIAL_CONSOLES}"
USE_VT = "0"
```

## conf/machine/t1040qds.conf
```bitbake
#@TYPE: Machine
#@DESCRIPTION: Machine configuration for running T1040QDS in 32-bit mode

require e5500.inc
require conf/machine/include/soc-family.inc

SOC_FAMILY = "t1040"
UBOOT_MACHINES ?= "T1040QDS"
KERNEL_DEVICETREE = "t1040qds.dtb t1040qds-usdpaa.dtb"
KERNEL_DEFCONFIG = "${S}/arch/powerpc/configs/corenet32_smp_defconfig"

JFFS2_ERASEBLOCK = "0x10000"

SERIAL_CONSOLES = "115200;ttyS0 115200;ttyS1 115200;ttyEHV0"
SERIAL_CONSOLES_CHECK = "${SERIAL_CONSOLES}"
USE_VT = "0"
```

## conf/machine/t1042rdb.conf
```bitbake
#@TYPE: Machine
#@NAME: Freescale T1042RDB
#@SOC: t1042
#@DESCRIPTION: Machine configuration for running T1042RDB in 32-bit mode
#@MAINTAINER: Chunrong Guo <B40290@freescale.com>

require conf/machine/include/e5500.inc

SOC_FAMILY = "t1:t1042"
UBOOT_MACHINES ?= "T1042RDB T1042RDB_SECURE_BOOT"
KERNEL_DEVICETREE ?= "t1042rdb.dtb"
KERNEL_DEFCONFIG ?= "${S}/arch/powerpc/configs/corenet32_fmanv3l_smp_defconfig"

JFFS2_ERASEBLOCK = "0x10000"
```
